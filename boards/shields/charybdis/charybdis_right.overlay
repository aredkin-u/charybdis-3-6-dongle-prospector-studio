#include "charybdis.dtsi"
#include "charybdis_3610.dtsi"
#include "split_input_common.dtsi"

&default_transform {
	col-offset = <6>;
};

&kscan0 {
	compatible = "zmk,kscan-gpio-matrix";
	
        = <&pro_micro 9 GPIO_ACTIVE_HIGH> // col1
        , <&pro_micro 8 GPIO_ACTIVE_HIGH> // col2
        , <&pro_micro 7 GPIO_ACTIVE_HIGH> // col3
        , <&pro_micro 6 GPIO_ACTIVE_HIGH> // col4
        , <&pro_micro 5 GPIO_ACTIVE_HIGH> // col5
        , <&pro_micro 4 GPIO_ACTIVE_HIGH> // col6
        ;

};

&trackball_split {
    device = <&trackball>;
};



